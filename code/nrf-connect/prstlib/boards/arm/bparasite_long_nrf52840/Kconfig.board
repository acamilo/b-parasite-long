## code/nrf-connect/prstlib/boards/arm/bparasite_long_nrf52840/Kconfig.board
```kconfig
config BOARD_BPARASITE_LONG_NRF52840
	bool "b-parasite nRF52840 board long version"
	depends on SOC_NRF52840_QIAA
```

## code/nrf-connect/prstlib/boards/arm/bparasite_long_nrf52840/Kconfig.defconfig
```kconfig
if BOARD_BPARASITE_LONG_NRF52840

config BOARD
	default "bparasite_long_nrf52840"

config BOARD_REVISION
	string "Board revision."
	default "0.0.1"

config BOARD_REVISION_CODE
	int "Board revision code. An integer representation of the board revision."
	default 1

config BT_CTLR
	default BT

endif  # BOARD_BPARASITE_LONG_NRF52840
```
